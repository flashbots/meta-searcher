## conf/layer.conf
```bitbake
# We have a conf and classes directory, add to BBPATH
BBPATH .= ":${LAYERDIR}"

# We have recipes-* directories, add to BBFILES
BBFILES += "${LAYERDIR}/recipes-*/*/*.bb \
            ${LAYERDIR}/recipes-*/*/*.bbappend"

BBFILE_COLLECTIONS += "meta-searcher"
BBFILE_PATTERN_meta-searcher = "^${LAYERDIR}/"
# Layers with higher priority values take precedence over layers with lower priority values. 
# Meta-searcher is configured to override meta-confidential-compute layer (priority 20)
BBFILE_PRIORITY_meta-searcher = "30"

LAYERDEPENDS_meta-searcher = "core"
LAYERSERIES_COMPAT_meta-searcher = "scarthgap"
```
